## arch/arm/mach-msm/lge/fx3/Kconfig
```kconfig
config BOARD_HEADER_FILE
	string "LGE board specific header file name"
	default ""

config MACH_MSM8930_FX3
	depends on ARCH_MSM8930
	select MACH_LGE
	bool "MSM8930 FX3"
	help
	  Support for the LGE MSM8930 FX3 device.

config MACH_LGE_L9II_COMMON
	bool "LGE L9II board"
	depends on MACH_MSM8930_FX3

config MACH_LGE_L9II_OPEN_EU
	bool "LGE L9II OPEN EU board"
	depends on MACH_MSM8930_FX3
```
